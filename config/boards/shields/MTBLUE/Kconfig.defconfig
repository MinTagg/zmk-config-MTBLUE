## config/boards/shields/mtblue/Kconfig.defconfig
```kconfig
if SHIELD_mtblue

config ZMK_KEYBOARD_NAME
    default "MTBLUE"

config I2C
    default y

config GPIO_MCP2300XX
    default y

config EC11
    default y

endif
```
